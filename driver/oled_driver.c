
#include "oled_driver.h"
#include "sw_iic.h"  // 我们刚刚抽离的软件 I2C 底层
#include <string.h>

// 假设你的系统设备头文件已经包含了 os_device_t 的定义
#include "vfs.h" 
static uint8_t g_cursor_x = 0;
static uint8_t g_cursor_y = 0;
static void oled_draw_point(uint8_t x, uint8_t y, uint8_t color);
static void oled_draw_char(uint8_t x, uint8_t y, char c);
static void oled_draw_string(uint8_t x, uint8_t y, const char *str);
#define OLED_I2C_ADDR 0x78 // SSD1306 默认地址
static const uint8_t font_6x8[96][6] = {
    {0x00,0x00,0x00,0x00,0x00,0x00}, {0x00,0x00,0x00,0x2f,0x00,0x00}, // Space, !
    {0x00,0x00,0x07,0x00,0x07,0x00}, {0x00,0x14,0x7f,0x14,0x7f,0x14}, // ", #
    {0x00,0x24,0x2a,0x7f,0x2a,0x12}, {0x00,0x23,0x13,0x08,0x64,0x62}, // $, %
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    {0x00,0x02,0x01,0x02,0x04,0x02}                                   // ~
};
// 全局静态设备实体和显存
static os_device_t oled_device;
static uint8_t g_oled_buffer[1024];

/* =======================================================
 * 内部硬件操作 (Hardware Abstraction)
 * ======================================================= */
static void oled_write_cmd(uint8_t cmd) {
    sw_i2c_start();
    sw_i2c_send_byte(OLED_I2C_ADDR);
    sw_i2c_send_byte(0x00); // 0x00 表示发送命令
    sw_i2c_send_byte(cmd);
    sw_i2c_stop();
}

static void oled_hw_init(void) {
    sw_i2c_init(); // 初始化 I2C GPIO引脚

    oled_write_cmd(0xAE); // 关闭显示
    oled_write_cmd(0x20); // 寻址模式
    oled_write_cmd(0x00); // 水平寻址
    oled_write_cmd(0xC8); // 翻转 COM 扫描方向 (控制上下翻转)
    oled_write_cmd(0xA1);// 翻转段重映射 (控制左右翻转)
    oled_write_cmd(0x8D); // 电荷泵设置
    oled_write_cmd(0x14); // 使能电荷泵
    oled_write_cmd(0xAF); // 开启显示
}

static void oled_refresh_screen(void) {
    for (uint8_t i = 0; i < 8; i++) {
        oled_write_cmd(0xB0 + i); 
        oled_write_cmd(0x00);     
        oled_write_cmd(0x10);     
        
        sw_i2c_start();
        sw_i2c_send_byte(OLED_I2C_ADDR);
        sw_i2c_send_byte(0x40); // 0x40 表示发送数据流
        
        for (uint8_t n = 0; n < 128; n++) {
            sw_i2c_send_byte(g_oled_buffer[i * 128 + n]);
        }
        sw_i2c_stop();
    }
}

/* =======================================================
 * VFS 接口实现 (契合 os_device_t 签名)
 * ======================================================= */
static int oled_open(os_device_t *dev, uint16_t flag) {
    oled_hw_init();
    memset(g_oled_buffer, 0, sizeof(g_oled_buffer));
    oled_refresh_screen(); // 上电清一次屏
    return 0;
}

static int oled_close(os_device_t *dev) {
    oled_write_cmd(0xAE); // 关闭显示以省电
    return 0;
}

static int oled_read(os_device_t *dev, uint32_t pos, void *buffer, uint32_t size) {
    // OLED 通常不需要读取显存，返回 0 即可
    return 0; 
}

static int oled_write(os_device_t *dev, uint32_t pos, const void *buffer, uint32_t size) {
    if (!buffer || size == 0) return 0;
    const char *str = (const char *)buffer;
    uint32_t count = 0;

    // 只要没写完传入的 size，且没遇到字符串结束符，就一直写
    while (count < size && *str) {
        if (*str == '\n') {
            // 遇到换行符：X 归零，Y 往下移一行 (8个像素)
            g_cursor_x = 0;
            g_cursor_y += 8;
        } 
        else if (*str == '\r') {
            // 回车符：X 归零
            g_cursor_x = 0;
        }
        else {
            // 越界保护：如果写到屏幕最底下了，清屏并从头开始写
            if (g_cursor_y > 56) {
                g_cursor_y = 0; 
                g_cursor_x = 0;
                memset(g_oled_buffer, 0, sizeof(g_oled_buffer)); 
            }

            // 画出这个字符
            oled_draw_char(g_cursor_x, g_cursor_y, *str);
            
            // 光标向右推进一步 (你的字库是 6x8)
            g_cursor_x += 6; 

            // 如果本行写满了，自动折行
            if (g_cursor_x > 122) {
                g_cursor_x = 0;
                g_cursor_y += 8;
            }
        }
        str++;
        count++;
    }
    
    // 返回成功写入的字节数
    return count;
}
static void oled_draw_point(uint8_t x, uint8_t y, uint8_t color) {
    if (x >= 128 || y >= 64) return;
    if (color) {
        g_oled_buffer[(y / 8) * 128 + x] |= (1 << (y % 8));
    } else {
        g_oled_buffer[(y / 8) * 128 + x] &= ~(1 << (y % 8));
    }
}

// 在指定坐标画一个 ASCII 字符
static void oled_draw_char(uint8_t x, uint8_t y, char c) {
    // 边界检查：如果字符不在字库范围内，用空格替代
    if (c < ' ' || c > '~') c = ' ';
    
    uint8_t font_idx = c - ' '; // 计算在字库数组里的偏移量
    
    // 一个 6x8 字符由 6 列构成，每列 8 个垂直像素点
    for (uint8_t i = 0; i < 6; i++) {
        uint8_t line = font_6x8[font_idx][i];
        for (uint8_t j = 0; j < 8; j++) {
            if (line & (1 << j)) {
                oled_draw_point(x + i, y + j, 1);
            } else {
                // 如果需要背景透明，把这行注释掉即可
                oled_draw_point(x + i, y + j, 0); 
            }
        }
    }
}

// 连续画字符串
static void oled_draw_string(uint8_t x, uint8_t y, const char *str) {
    while (*str) {
        // 如果画到了屏幕最右边，自动换行到下一行 (字高为 8)
        if (x > 122) { 
            x = 0;
            y += 8;
        }
        // 如果超出了屏幕底部，直接丢弃
        if (y > 56) break; 
        
        oled_draw_char(x, y, *str);
        x += 6; // 每个字符宽度为 6
        str++;
    }
}
static int oled_ioctl(os_device_t *dev, int cmd, void *args) {
    switch (cmd) {
        case OLED_IOC_UPDATE_SCREEN: 
            oled_refresh_screen(); 
            break;
            
        case OLED_IOC_CLEAR_BUFFER:  
            memset(g_oled_buffer, 0, sizeof(g_oled_buffer)); 
            g_cursor_x = 0; // 【新增】清屏的同时，把打字机光标复位到最左上角
            g_cursor_y = 0; // 【新增】防止清屏后字接着跑到屏幕中间
            break;
        
        case OLED_IOC_DRAW_POINT: {
            oled_point_t *p = (oled_point_t *)args;
            if (p) oled_draw_point(p->x, p->y, p->color);
            break;
        }
        
        // 新增的画字符串控制指令
        case OLED_IOC_DRAW_STRING: {
            oled_string_t *s = (oled_string_t *)args;
            if (s && s->str) {
                oled_draw_string(s->x, s->y, s->str);
            }
            break;
        }
        
        default: return -1;
    }
    return 0;
}
/* =======================================================
 * 驱动注册入口
 * ======================================================= */
int oled_register(const char *name) {
    // 因为 OLED 是单例设备（通常只会接一块屏幕），所以不需要像 mq 那样做数组遍历
    oled_device.name         = name;
    oled_device.open         = oled_open;
    oled_device.close        = oled_close;
    oled_device.read         = oled_read;
    oled_device.write        = oled_write;
    oled_device.ioctl        = oled_ioctl;
    oled_device.private_data = NULL;

    // 挂载到 VFS 设备树
    // 注意：请确保你的系统中有 vfs_register_device 的声明
    vfs_register_device(&oled_device); 
    
    return 0;
}